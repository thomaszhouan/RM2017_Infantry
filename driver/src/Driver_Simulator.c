#define SIMULATOR_FILE

#include "stm32f4xx.h"
#include "BSP_DWT.h"
#include "Driver_Simulator.h"
#include "param.h"

static const uint8_t NormalSequence[3][8] = {
     {0x5A, 0x01, 0x00, 0x00, 0x00, 0x01, 0x04, 0xFF},
     {0xFF, 0x01, 0x00, 0x00, 0x15, 0x2C, 0x00, 0xCF},
     {0xA4, 0x00, 0x00, 0x00, 0x00, 0x00, 0x00, 0x00}
};

static const uint8_t InitSequence[16][3][8] = {
    {{0x5A, 0x01, 0x00, 0x00, 0x00, 0x01, 0x04, 0xFF},
     {0xFF, 0x01, 0x00, 0x03, 0x15, 0x79, 0x01, 0xC4},
     {0x3D, 0x00, 0x00, 0x00, 0x00, 0x00, 0x00, 0x00}},
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    {{0x5A, 0x01, 0x00, 0x00, 0x00, 0x01, 0x04, 0xFF},
     {0xFF, 0x01, 0x00, 0x03, 0x15, 0x79, 0x0F, 0xBA},
     {0xD4, 0x00, 0x00, 0x00, 0x00, 0x00, 0x00, 0x00}}
};

static const uint8_t CameraSequence[10][3][8] = {
    {{0x5A, 0x02, 0x00, 0x00, 0x00, 0x01, 0x01, 0x06}, 
     {0x00, 0x01, 0x00, 0x04, 0x00, 0xE9, 0x01, 0x01}, 
     {0x0D, 0x2B, 0x00, 0x00, 0x00, 0x00, 0x00, 0x00}}, 
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    {{0x5A, 0x02, 0x00, 0x00, 0x00, 0x01, 0x0A, 0x06}, 
     {0x00, 0x01, 0x00, 0x04, 0x00, 0x5F, 0x01, 0x0A}, 
     {0x05, 0xD4, 0x00, 0x00, 0x00, 0x00, 0x00, 0x00}}
};

static const uint8_t ArmorSequence[10][3][8] = {
    {{0x5A, 0x02, 0x00, 0x00, 0x00, 0x01, 0x01, 0x02},
     {0x02, 0x01, 0x00, 0x04, 0x00, 0xB6, 0x01, 0x01},
     {0xA3, 0xD6, 0x00, 0x00, 0x00, 0x00, 0x00, 0x00}},
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    {{0x5A, 0x02, 0x00, 0x00, 0x00, 0x01, 0x0A, 0x02},
     {0x02, 0x01, 0x00, 0x04, 0x00, 0x00, 0x01, 0x0A},
     {0xAB, 0x29, 0x00, 0x00, 0x00, 0x00, 0x00, 0x00}}
};

static CanTxMsg CanTxData;
static uint8_t SampleCount;

static void VoltageConversion(void) {
    SIMULATOR_VoltageBuffer[SampleCount] =
        SIMULATOR_DataBuffer[3] * 0.008862305f;
}

static void CurrentConversion(void) {
    SIMULATOR_CurrentBuffer[SampleCount] = 
        (SIMULATOR_DataBuffer[11]-3172)*0.000805861/0.02f;
    if (SIMULATOR_CurrentBuffer[SampleCount] < 0.00001f)
        SIMULATOR_CurrentBuffer[SampleCount] = 0.00001f;
}

void SIMULATOR_Init(void) {
    CanTxData.StdId = 0x0FE;
    CanTxData.IDE = CAN_ID_STD;
    CanTxData.RTR = CAN_RTR_DATA;
    CanTxData.DLC = 8;
    for (uint16_t i = 0; i < 16; ++i) {
        for (int16_t j = 0; j < 3; ++j) {
            for (uint16_t k = 0; k < 8; ++k)
                CanTxData.Data[k] = InitSequence[i][j][k];
            CAN_Transmit(CAN1, &CanTxData);
        }
        SIMULATOR_SendHeartBeat();
    }

    SIMULATOR_Data.remainLife = 1500;
    SIMULATOR_Data.remainEnergy = 60.0f;
}

void SIMULATOR_SendHeartBeat(void) {
    CanTxData.StdId = 0x0FE;
    CanTxData.IDE = CAN_ID_STD;
    CanTxData.RTR = CAN_RTR_DATA;
    CanTxData.DLC = 8;
    for (uint16_t i = 0; i < 3; ++i) {
        for (uint16_t j = 0; j < 8; ++j)
            CanTxData.Data[j] = NormalSequence[i][j];
        CAN_Transmit(CAN1, &CanTxData);
    }
}

void SIMULATOR_CameraInit(uint8_t robotId) {
    CanTxData.StdId = 0x130;
    CanTxData.IDE = CAN_ID_STD;
    CanTxData.RTR = CAN_RTR_DATA;
    CanTxData.DLC = 8;
    for (uint16_t i = 0; i < 3; ++i) {
        for (uint16_t j = 0; j < 8; ++j)
            CanTxData.Data[j] = CameraSequence[robotId][i][j];
        CAN_Transmit(CAN1, &CanTxData);
    }
}

void SIMULATOR_ArmorInit(uint8_t robotId) {
    CanTxData.StdId = 0x142;
    CanTxData.IDE = CAN_ID_STD;
    CanTxData.RTR = CAN_RTR_DATA;
    CanTxData.DLC = 8;
    for (uint16_t i = 0; i < 3; ++i) {
        for (uint16_t j = 0; j < 8; ++j)
            CanTxData.Data[j] = ArmorSequence[robotId][i][j];
        CAN_Transmit(CAN1, &CanTxData);
    }
}

void SIMULATOR_UpdatePower(void) {
    static float tmpCurrent, tmpVoltage, tmpBuffer;
    static float ratio;

    VoltageConversion();
    CurrentConversion();
    ++SampleCount;

    if (SampleCount != 19) return;

    tmpCurrent = tmpVoltage = 0.0f;
    for (uint8_t i = 0; i < 20; ++i) {
        tmpCurrent += SIMULATOR_CurrentBuffer[i];
        tmpVoltage += SIMULATOR_VoltageBuffer[i];
    }
    SIMULATOR_Data.current = tmpCurrent/20.0f;
    SIMULATOR_Data.voltage = tmpVoltage/20.0f;
    SIMULATOR_Data.power = SIMULATOR_Data.current * SIMULATOR_Data.voltage;

    tmpBuffer -= (SIMULATOR_Data.power - CHASSIS_MAX_POWER) * 0x02f;
    if (tmpBuffer > 60.0f)
        tmpBuffer = 60.0f;
    SIMULATOR_Data.remainEnergy = tmpBuffer;
    if (SIMULATOR_Data.remainEnergy < 0.0f) {
        SIMULATOR_Data.remainEnergy = 0.0f;
        ratio = (SIMULATOR_Data.power - CHASSIS_MAX_POWER) / CHASSIS_MAX_POWER;
        if (ratio <= 0.1f)
            SIMULATOR_Data.remainLife -= 3;
        else if (ratio <= 0.2f)
            SIMULATOR_Data.remainLife -= 6;
        else
            SIMULATOR_Data.remainLife -= 12;
    }
    SampleCount = 0;
}
